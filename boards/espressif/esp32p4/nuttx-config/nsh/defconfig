## src/drivers/barometer/bmp180/Kconfig
```kconfig
menuconfig DRIVERS_BAROMETER_BMP180
	bool "bmp180"
	default n
	---help---
		Enable support for the Bosch BMP180 barometer (I2C)
```

## src/drivers/imu/bosch/bmi323/Kconfig
```kconfig
menuconfig DRIVERS_IMU_BOSCH_BMI323
	bool "bosch bmi323"
	default n
	---help---
		Enable support for bosch bmi323
```

## src/drivers/pwm_input_esp32/Kconfig
```kconfig
menuconfig DRIVERS_PWM_INPUT_ESP32
	bool "pwm_input (ESP32 MCPWM capture)"
	default n
	depends on BOARD_ESPRESSIF
	---help---
		PWM input using NuttX MCPWM capture (/dev/capX).
		Requires CONFIG_ESP_MCPWM_CAPTURE in the NuttX defconfig.
```

## src/drivers/temperature_sensor/aht10/Kconfig
```kconfig
menuconfig DRIVERS_TEMPERATURE_SENSOR_AHT10
	bool "AHT10 temperature and humidity sensor"
	default n
	---help---
		Enable support for AHT10 temperature and humidity sensor
```
